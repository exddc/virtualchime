## buildroot/Config.in
```kconfig
# Chime external packages
source "$BR2_EXTERNAL_VIRTUALCHIME_PATH/package/chime/Config.in"
```

## buildroot/configs/virtualchime_rpi0w_defconfig
```kconfig
# Raspberry Pi Zero W Buildroot defconfig
# Based on raspberrypi0w_defconfig with customizations for chime

# Architecture: ARMv6 (BCM2835)
BR2_arm=y
BR2_arm1176jzf_s=y

# Toolchain
BR2_TOOLCHAIN_BUILDROOT_GLIBC=y
BR2_TOOLCHAIN_BUILDROOT_CXX=y
BR2_GCC_VERSION_12_X=y

# System configuration
BR2_TARGET_GENERIC_HOSTNAME="chime"
BR2_TARGET_GENERIC_ISSUE="Virtual Chime"
BR2_SYSTEM_DHCP="wlan0"
BR2_TARGET_GENERIC_ROOT_PASSWD=""
BR2_ROOTFS_OVERLAY="$(BR2_EXTERNAL_VIRTUALCHIME_PATH)/board/raspberrypi0w/rootfs_overlay"
BR2_ROOTFS_POST_BUILD_SCRIPT="$(BR2_EXTERNAL_VIRTUALCHIME_PATH)/board/raspberrypi0w/post_build.sh"
BR2_ROOTFS_POST_IMAGE_SCRIPT="$(BR2_EXTERNAL_VIRTUALCHIME_PATH)/board/raspberrypi0w/post_image.sh"

# Kernel
BR2_LINUX_KERNEL=y
BR2_LINUX_KERNEL_CUSTOM_TARBALL=y
BR2_LINUX_KERNEL_CUSTOM_TARBALL_LOCATION="https://github.com/raspberrypi/linux/archive/refs/tags/stable_20250127.tar.gz"
BR2_LINUX_KERNEL_DEFCONFIG="bcmrpi"
BR2_LINUX_KERNEL_DTS_SUPPORT=y
BR2_LINUX_KERNEL_INTREE_DTS_NAME="broadcom/bcm2708-rpi-zero-w"
BR2_LINUX_KERNEL_NEEDS_HOST_OPENSSL=y

# Bootloader
BR2_PACKAGE_RPI_FIRMWARE=y
BR2_PACKAGE_RPI_FIRMWARE_VARIANT_PI=y

# Filesystem
BR2_TARGET_ROOTFS_EXT2=y
BR2_TARGET_ROOTFS_EXT2_4=y
BR2_TARGET_ROOTFS_EXT2_SIZE="256M"

# SD card image
BR2_PACKAGE_HOST_GENIMAGE=y
BR2_PACKAGE_HOST_DOSFSTOOLS=y
BR2_PACKAGE_HOST_MTOOLS=y

# Init system
BR2_INIT_BUSYBOX=y

# Networking packages
BR2_PACKAGE_DHCPCD=y
BR2_PACKAGE_IW=y
BR2_PACKAGE_WPA_SUPPLICANT=y
BR2_PACKAGE_WPA_SUPPLICANT_NL80211=y
BR2_PACKAGE_WPA_SUPPLICANT_AUTOSCAN=y
BR2_PACKAGE_WPA_SUPPLICANT_CTRL_IFACE=y
BR2_PACKAGE_WIRELESS_REGDB=y
BR2_PACKAGE_BRCMFMAC_SDIO_FIRMWARE_RPI=y
BR2_PACKAGE_BRCMFMAC_SDIO_FIRMWARE_RPI_WIFI=y
BR2_PACKAGE_MOSQUITTO=y

# Module loading
BR2_PACKAGE_KMOD=y
BR2_PACKAGE_KMOD_TOOLS=y

# SSH
BR2_PACKAGE_DROPBEAR=y
BR2_PACKAGE_DROPBEAR_DISABLE_REVERSEDNS=y

# Utilities
BR2_PACKAGE_BUSYBOX_SHOW_OTHERS=y

# Timezone
BR2_TARGET_LOCALTIME="UTC"

# Chime application
BR2_PACKAGE_CHIME=y
```

## buildroot/package/chime/Config.in
```kconfig
config BR2_PACKAGE_CHIME
	bool "chime"
	depends on BR2_INSTALL_LIBSTDCPP
	select BR2_PACKAGE_MOSQUITTO
	select BR2_PACKAGE_OPENSSL
	help
	  Chime doorbell application.

	  This is the main chime notification daemon that receives
	  doorbell events and plays audio notifications.

	  https://github.com/exddc/virtualchime

comment "chime needs a toolchain w/ C++"
	depends on !BR2_INSTALL_LIBSTDCPP
```
